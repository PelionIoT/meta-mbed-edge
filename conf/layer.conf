## conf/layer.conf
```bitbake
# We have a conf and classes directory, add to BBPATH
BBPATH .= ":${LAYERDIR}"

# We have recipes-* directories, add to BBFILES
BBFILES += "${LAYERDIR}/recipes-*/*/*.bb \
	${LAYERDIR}/recipes-*/*/*.bbappend"

BBFILE_COLLECTIONS += "meta-mbed-edge"
BBFILE_PATTERN_meta-mbed-edge = "^${LAYERDIR}/"
BBFILE_PRIORITY_meta-mbed-edge = "6"
LAYERSERIES_COMPAT_meta-mbed-edge = "dunfell gatesgarth"
LAYERDEPENDS_meta-mbed-edge = "rust-layer clang-layer"
```
